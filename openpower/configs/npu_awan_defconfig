## openpower/configs/npu_awan_defconfig
```kconfig
BR2_powerpc64le=y
BR2_powerpc_power8=y
BR2_BINUTILS_EXTRA_CONFIG_OPTIONS="--enable-targets=powerpc64-linux"
BR2_EXTRA_GCC_CONFIG_OPTIONS="--enable-targets=powerpc64-linux --disable-libsanitizer"
BR2_ROOTFS_POST_BUILD_SCRIPT="../openpower/custom/scripts/awan ../openpower/custom/scripts/fstab-debugfs"
BR2_LINUX_KERNEL=y
BR2_LINUX_KERNEL_USE_CUSTOM_CONFIG=y
BR2_LINUX_KERNEL_CUSTOM_CONFIG_FILE="$(BR2_EXTERNAL_OP_BUILD_PATH)/custom/configs/linux/mini.config"
BR2_LINUX_KERNEL_CONFIG_FRAGMENT_FILES="$(BR2_EXTERNAL_OP_BUILD_PATH)/custom/configs/linux/npu.config"
BR2_LINUX_KERNEL_VMLINUX=y
BR2_LINUX_KERNEL_NEEDS_HOST_OPENSSL=y
BR2_PACKAGE_BUSYBOX_CONFIG_FRAGMENT_FILES="$(BR2_EXTERNAL_OP_BUILD_PATH)/configs/busybox.fragment"
BR2_PACKAGE_BUSYBOX_SHOW_OTHERS=y
BR2_PACKAGE_PCIUTILS=y
BR2_TARGET_ROOTFS_CPIO=y
# BR2_TARGET_ROOTFS_TAR is not set
BR2_OPENPOWER_PLATFORM=y
BR2_OPENPOWER_POWER9=y
# BR2_PACKAGE_HOST_OPENPOWER_FFS is not set
# BR2_PACKAGE_HOSTBOOT is not set
# BR2_PACKAGE_HOSTBOOT_BINARIES is not set
# BR2_PACKAGE_MACHINE_XML is not set
# BR2_OPENPOWER_MACHINE_XML_FILTER_UNWANTED_ATTRIBUTES is not set
# BR2_OPENPOWER_MACHINE_XML_OPPOWERVM_ATTRIBUTES is not set
# BR2_OPENPOWER_MACHINE_XML_TARGET_TYPES_OPENPOWER_XML is not set
# BR2_PACKAGE_OPENPOWER_PNOR is not set
# BR2_TARGET_SKIBOOT_XZ is not set
# BR2_PACKAGE_HCODE is not set
# BR2_PACKAGE_OCC is not set
# BR2_PACKAGE_CAPP_UCODE is not set
BR2_SKIBOOT_CUSTOM_VERSION=y
BR2_SKIBOOT_CUSTOM_VERSION_VALUE="v6.4-152-g4f8b3234b872"
BR2_SKIBOOT_CUSTOM_GIT=y
BR2_SKIBOOT_CUSTOM_REPO_URL="git://github.com/rarbab/skiboot"
BR2_SKIBOOT_DEVICETREE=y
BR2_SKIBOOT_DEBUG=y
# BR2_PACKAGE_HOST_PPE42_BINUTILS is not set
# BR2_PACKAGE_HOST_PPE42_GCC is not set
# BR2_PACKAGE_IMA_CATALOG is not set
# BR2_PACKAGE_HOST_SB_SIGNING_UTILS is not set
BR2_PACKAGE_NPU=y
```

## openpower/configs/npu_simics_defconfig
```kconfig
BR2_powerpc64le=y
BR2_powerpc_power8=y
BR2_BINUTILS_EXTRA_CONFIG_OPTIONS="--enable-targets=powerpc64-linux"
BR2_EXTRA_GCC_CONFIG_OPTIONS="--enable-targets=powerpc64-linux --disable-libsanitizer"
BR2_ROOTFS_DEVICE_TABLE="system/device_table.txt ../openpower/custom/device_table/sshd.txt"
BR2_ROOTFS_OVERLAY="../openpower/custom/overlay/simics ../openpower/custom/overlay/sshd"
BR2_ROOTFS_POST_BUILD_SCRIPT="../openpower/custom/scripts/fstab-debugfs"
BR2_LINUX_KERNEL=y
BR2_LINUX_KERNEL_DEFCONFIG="ppc64le"
BR2_LINUX_KERNEL_CONFIG_FRAGMENT_FILES="$(BR2_EXTERNAL_OP_BUILD_PATH)/custom/configs/linux/npu.config"
BR2_LINUX_KERNEL_VMLINUX=y
BR2_LINUX_KERNEL_NEEDS_HOST_OPENSSL=y
BR2_PACKAGE_BUSYBOX_CONFIG_FRAGMENT_FILES="$(BR2_EXTERNAL_OP_BUILD_PATH)/configs/busybox.fragment"
BR2_PACKAGE_BUSYBOX_SHOW_OTHERS=y
BR2_PACKAGE_PCIUTILS=y
BR2_PACKAGE_DTC=y
BR2_PACKAGE_DTC_PROGRAMS=y
BR2_PACKAGE_HAVEGED=y
BR2_PACKAGE_OPENSSH=y
BR2_PACKAGE_POWERPC_UTILS=y
BR2_TARGET_ROOTFS_CPIO=y
# BR2_TARGET_ROOTFS_TAR is not set
BR2_OPENPOWER_PLATFORM=y
BR2_OPENPOWER_POWER9=y
# BR2_PACKAGE_HOST_OPENPOWER_FFS is not set
# BR2_PACKAGE_HOSTBOOT is not set
# BR2_PACKAGE_HOSTBOOT_BINARIES is not set
# BR2_PACKAGE_MACHINE_XML is not set
# BR2_OPENPOWER_MACHINE_XML_FILTER_UNWANTED_ATTRIBUTES is not set
# BR2_OPENPOWER_MACHINE_XML_OPPOWERVM_ATTRIBUTES is not set
# BR2_OPENPOWER_MACHINE_XML_TARGET_TYPES_OPENPOWER_XML is not set
# BR2_PACKAGE_OPENPOWER_PNOR is not set
# BR2_TARGET_SKIBOOT_XZ is not set
# BR2_PACKAGE_HCODE is not set
# BR2_PACKAGE_OCC is not set
# BR2_PACKAGE_CAPP_UCODE is not set
BR2_SKIBOOT_CUSTOM_VERSION=y
BR2_SKIBOOT_CUSTOM_VERSION_VALUE="v6.4-173-g78e01c18ea1d"
BR2_SKIBOOT_CUSTOM_GIT=y
BR2_SKIBOOT_CUSTOM_REPO_URL="git://github.com/rarbab/skiboot"
BR2_SKIBOOT_DEVICETREE=y
BR2_SKIBOOT_DEBUG=y
# BR2_PACKAGE_HOST_PPE42_BINUTILS is not set
# BR2_PACKAGE_HOST_PPE42_GCC is not set
# BR2_PACKAGE_IMA_CATALOG is not set
# BR2_PACKAGE_HOST_SB_SIGNING_UTILS is not set
BR2_PACKAGE_NPU=y
```

## openpower/configs/nvidia_defconfig
```kconfig
BR2_powerpc64le=y
BR2_powerpc_power8=y
BR2_PACKAGE_HOST_LINUX_HEADERS_CUSTOM_5_0=y
BR2_BINUTILS_EXTRA_CONFIG_OPTIONS="--enable-targets=powerpc64-linux"
BR2_EXTRA_GCC_CONFIG_OPTIONS="--enable-targets=powerpc64-linux --disable-libsanitizer"
BR2_ROOTFS_DEVICE_TABLE="system/device_table.txt ../openpower/custom/device_table/sshd.txt"
BR2_TARGET_GENERIC_GETTY_PORT="hvc0"
BR2_ROOTFS_OVERLAY="../openpower/custom/overlay/opal ../openpower/custom/overlay/sshd ../openpower/custom/overlay/npu ../openpower/custom/overlay/nvidia-driver"
BR2_ROOTFS_POST_BUILD_SCRIPT="../openpower/custom/scripts/fstab-debugfs"
BR2_LINUX_KERNEL=y
BR2_LINUX_KERNEL_CUSTOM_VERSION=y
BR2_LINUX_KERNEL_CUSTOM_VERSION_VALUE="5.0.21"
BR2_LINUX_KERNEL_DEFCONFIG="ppc64le"
BR2_LINUX_KERNEL_CONFIG_FRAGMENT_FILES="$(BR2_EXTERNAL_OP_BUILD_PATH)/custom/configs/linux/npu.config"
BR2_LINUX_KERNEL_VMLINUX=y
BR2_LINUX_KERNEL_XZ=y
BR2_LINUX_KERNEL_NEEDS_HOST_OPENSSL=y
BR2_PACKAGE_BUSYBOX_CONFIG_FRAGMENT_FILES="$(BR2_EXTERNAL_OP_BUILD_PATH)/configs/busybox.fragment"
BR2_PACKAGE_BUSYBOX_SHOW_OTHERS=y
BR2_PACKAGE_NVIDIA_DRIVER=y
BR2_PACKAGE_NVIDIA_DRIVER_CUSTOM_VERSION=y
BR2_PACKAGE_NVIDIA_DRIVER_CUSTOM_VERSION_VALUE="418.67"
BR2_PACKAGE_NVIDIA_DRIVER_USE_CUSTOM_RUNFILE=y
BR2_PACKAGE_NVIDIA_DRIVER_CUSTOM_RUNFILE="$(HOME)/src/NVIDIA-Linux-ppc64le-$(NVIDIA_DRIVER_VERSION).run"
BR2_PACKAGE_NVIDIA_DRIVER_CUDA=y
BR2_PACKAGE_NVIDIA_DRIVER_MODULE=y
# BR2_PACKAGE_NVIDIA_DRIVER_MODULE_DRM is not set
BR2_PACKAGE_NVIDIA_DRIVER_MODULE_PROGS=y
BR2_PACKAGE_PCIUTILS=y
BR2_PACKAGE_PDBG=y
BR2_PACKAGE_DTC=y
BR2_PACKAGE_DTC_PROGRAMS=y
BR2_PACKAGE_BC=y
BR2_PACKAGE_HAVEGED=y
BR2_PACKAGE_OPENSSH=y
BR2_PACKAGE_CGROUPFS_MOUNT=y
BR2_PACKAGE_NUMACTL=y
BR2_PACKAGE_POWERPC_UTILS=y
BR2_PACKAGE_LESS=y
BR2_TARGET_ROOTFS_CPIO=y
BR2_TARGET_ROOTFS_CPIO_XZ=y
# BR2_TARGET_ROOTFS_TAR is not set
BR2_PACKAGE_NPU=y
```
